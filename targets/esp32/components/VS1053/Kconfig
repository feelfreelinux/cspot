## targets/esp32/components/VS1053/Kconfig
```kconfig
menu "VS1053 Configuration"

        menu "VS1053 PIN Configuration"

        config GPIO_MISO
                int "GPIO pin MISO"
        range -1 39
                default 19

        config GPIO_MOSI
                int "GPIO pin MOSI"
        range -1 39
                default 23

        config GPIO_CLK
                int "GPIO pin CLK"
        range -1 39
                default 18

        config GPIO_VS_CS
                int "GPIO pin VS CS"
        range -1 39
                default 4

        config GPIO_VS_DCS
                int "GPIO pin VS DCS"
        range -1 39
                default 21

        config GPIO_VS_RESET
                int "GPIO pin VS RESET"
        range -1 39
                default 0

        config GPIO_VS_DREQ
                int "GPIO pin VS DREQ"
        range -1 39
                default 22

        config GPIO_SD_CS
                int "GPIO pin SD CS"
        range -1 39
                default 5
        endmenu

choice VS_PLUGIN
        prompt "VS1053 plugin"
        default VS_FLAC
        help 
                you have to choose between special audio compability or a spectrum analyzer
        config VS_DSD64
                bool "with dsd patch"
        config VS_FLAC
                bool "with flac patch"
        config VS_FLAC_LATM
                bool "with flac & latm/loas patch"
        config VS_LATM
                bool "with latm/loas patch"
        config VS_PITCH
                bool "with pitch plugin"
        config VS_SPECTRUM_ANALYZER
                bool "with spectrum analyzer plugin"
endchoice


config REPORT_ON_SCREEN
        bool "REPORT_ON_SCREEN"
        
endmenu
```

## targets/esp32/main/Kconfig.projbuild
```kconfig
menu "CSPOT Configuration"

    config CSPOT_DEVICE_NAME
        string "CSpot Device Name"
        default "CSpot-ESP32"
        help
            Define the name of the cspot device (will be visible to the client).

    choice CSPOT_SINK
        prompt "Sink Device"
        default CSPOT_SINK_INTERNAL
        help
            Select audio sink device
        
        config BELL_NOCODEC
            bool "VS1053"
        config CSPOT_SINK_INTERNAL
            bool "Built-in DAC"
        config CSPOT_SINK_AC101
            bool "AC101"
        config CSPOT_SINK_ES8388
            bool "ES8388"
        config CSPOT_SINK_ES9018
            bool "ES8018"
        config CSPOT_SINK_PCM5102
            bool "PCM5102"
        config CSPOT_SINK_TAS5711
            bool "TAS5711"
    endchoice

    choice CSPOT_QUALITY
        prompt "Audio Quality (BPS)"
        default VORBIS_160
        help
            Audio quality (not used currently)
        config VORBIS_320
            bool "320 bps"
        config VORBIS_160
            bool "160 bps"
        config VORBIS_96
            bool "96 bps"
    endchoice

    config CSPOT_AUDIO_FORMAT
        int
        default 0 if VORBIS_96
        default 1 if VORBIS_160
        default 2 if VORBIS_320
        default 3 if MP3_256
        default 4 if MP3_320
        default 5 if MP3_160
        default 6 if MP3_96
        default 7 if MP3_160_ENC
        default 8 if AAC_24
        default 9 if AAC_48

    choice CSPOT_STATUS_LED_TYPE
        prompt "Status LED type"
        default CSPOT_STATUS_LED_TYPE_NONE
        help
            Defines the default peripheral for status led

        config CSPOT_STATUS_LED_TYPE_NONE
            bool "No status LED"
        config CSPOT_STATUS_LED_TYPE_GPIO
            bool "GPIO"
        config CSPOT_STATUS_LED_TYPE_RMT
            bool "RMT - Addressable LED"
    endchoice
    choice CSPOT_LOGIN
    prompt "Login type"
    default CSPOT_LOGIN_ZEROCONF
    help
        Select login form

    config CSPOT_LOGIN_ZEROCONF
        bool "Login with zeroconfServer"
        help
            login with zeroconf
    config CSPOT_LOGIN_PASS
        bool "Login with password"    
    endchoice

    menu "username & password"
        visible if CSPOT_LOGIN_PASS
        config CSPOT_LOGIN_USERNAME
        string "Spotify username"
        default "username"
        config CSPOT_LOGIN_PASSWORD
        string "Spotify password"
        default "password"
        help
            login with username and password
        endmenu

    config UPDATE_FUTURE_TRACKS
        int "Send tracks to spotify"
    range 0 100
        default 10
        help
            How many tracks are visible in the currently playing header
            
    config CSPOT_STATUS_LED_GPIO
        int "Status LED GPIO number"
        range 0 48
        default 5
        help
            Status GPIO number (IOxx) to blink or the RMT signal for the addressable LED.

    config CSPOT_STATUS_LED_RMT_CHANNEL
        depends on CSPOT_STATUS_LED_TYPE_RMT
        int "Status LED RMT Channel"
        range 0 7
        default 0
        help
            Set the RMT peripheral channel.
            ESP32 RMT channel from 0 to 7
            ESP32-S2 RMT channel from 0 to 3
            ESP32-S3 RMT channel from 0 to 3
            ESP32-C3 RMT channel from 0 to 1

endmenu
```
